## config/boards/shields/footswitch/Kconfig.defconfig
```kconfig
if SHIELD_FOOTSWITCH

if ZMK_DISPLAY

config I2C
    default y

config SSD1306
    default y
endif
endif
```

## config/dts/bindings/behaviors/behavior-layer-cycle.yaml
```yaml
title: Layer Cycle Behavior

description: >
  Custom behavior to cycle through layers (mouse or keyboard group)

compatible: "zmk,behavior-layer-cycle"

include: one_param.yaml

properties:
  label:
    required: true
    type: string
```
